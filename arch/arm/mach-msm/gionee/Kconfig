## arch/arm/mach-msm/gionee/Kconfig
```kconfig
config GN_MACH_GIONEE
	bool
	depends on ARCH_MSM

menu "Gionee board selection"

config GN_MACH_MSM8974_NBL8910A_SUPPORT
	bool "IUNI U3"
	select GN_MACH_GIONEE
	help
	  Support for the IUNI U3 (NBL8910A)

endmenu
```
